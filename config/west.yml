## config/west.yml
```yaml
manifest:
  remotes:
    - name: lowprokb
      url-base: https://github.com/LOWPROKB
  projects:
    - name: zmk
      remote: lowprokb
      revision: corne-ish-zen-v2
      import: app/west.yml
  self:
    path: config
    
```
